## west.yml
```yaml
# Copyright (c) 2021 Nordic Semiconductor ASA
# SPDX-License-Identifier: Apache-2.0

manifest:
  self:
    west-commands: scripts/west-commands.yml

  remotes:
    - name: zephyrproject-rtos
      url-base: https://github.com/zephyrproject-rtos
    - name: trustedfirmware
      url-base: https://git.trustedfirmware.org/TF-A

  projects:
    - name: zephyr
      remote: zephyrproject-rtos
      revision: main
      import:
        # By using name-allowlist we can clone only the modules that are
        # strictly needed by the application.
        name-allowlist:
          - cmsis_6    # required by the ARM port for Cortex-M
          - hal_nordic # required by the custom_plank board (Nordic based)
          - hal_stm32  # required by the nucleo_f302r8 board (STM32 based)
    - name: trusted-firmware-a
      remote: trustedfirmware
      repo-path: trusted-firmware-a.git
      revision: v2.11.0
      path: tfa
```

## yocto/meta-safety-monitor/conf/layer.conf
```bitbake
BBPATH .= ":${LAYERDIR}"
BBFILES += "${LAYERDIR}/recipes-*/*/*.bb"

BBFILE_COLLECTIONS += "safety-monitor"
BBFILE_PATTERN_safety-monitor = "^${LAYERDIR}/"
BBFILE_PRIORITY_safety-monitor = "10"

LAYERDEPENDS_safety-monitor = "core"
LAYERSERIES_COMPAT_safety-monitor = "kirkstone scarthgap"
```
