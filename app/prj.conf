## CMakeLists.txt
```
#-------------------------------------------------------------------------------
# Zephyr Example Application
#
# Copyright (c) 2021 Nordic Semiconductor ASA
# SPDX-License-Identifier: Apache-2.0

cmake_minimum_required(VERSION 3.13.1)
find_package(Zephyr REQUIRED HINTS $ENV{ZEPHYR_BASE})

project(app LANGUAGES C)

target_sources(app PRIVATE
	src/main.c
	src/safety_monitor.c
	src/resource_monitor.c
)
```

## Kconfig
```
# Copyright (c) 2021 Nordic Semiconductor ASA
# SPDX-License-Identifier: Apache-2.0
#
# This file is the application Kconfig entry point. All application Kconfig
# options can be defined here or included via other application Kconfig files.
# You can browse these options using the west targets menuconfig (terminal) or
# guiconfig (GUI).

menu "Zephyr"
source "Kconfig.zephyr"
endmenu

module = APP
module-str = APP
source "subsys/logging/Kconfig.template.log_config"

config APP_SAMPLE_PERIOD_MS
	int "Safety monitor sample period (ms)"
	default 100
	range 1 60000

config APP_WARNING_SAMPLES
	int "Valid hazard samples before warning"
	default 2
	range 1 255

config APP_EMERGENCY_SAMPLES
	int "Valid hazard samples before emergency"
	default 5
	range APP_WARNING_SAMPLES 255

config APP_FAULT_SAMPLES
	int "Invalid samples before sensor fault"
	default 3
	range 1 255

config APP_RESOURCE_MONITOR
	bool "Periodic CPU/stack resource reporting"
	select THREAD_ANALYZER
	select THREAD_NAME
	select THREAD_RUNTIME_STATS
	default y
	help
	  Periodically logs per-thread CPU load and stack usage using
	  Zephyr's thread analyzer subsystem, alongside a bare-metal
	  interrupt-mask read implemented in inline assembly.

config APP_RESOURCE_MONITOR_PERIOD_MS
	int "Resource report period (ms)"
	default 5000
	range 100 3600000
	depends on APP_RESOURCE_MONITOR
```

## sample.yaml
```
# This file is provided so that the application can be compiled using Twister,
# the Zephyr testing tool. In this file, multiple combinations can be specified,
# so that you can easily test all of them locally or in CI.
sample:
  description: Zephyr safety monitor node
  name: zephyr-safety-monitor
common:
  build_only: true
  integration_platforms:
    - custom_plank
    - nucleo_f302r8
tests:
  app.default: {}
  app.debug:
    extra_overlay_confs:
      - debug.conf
```

## prj.conf
```kconfig
# Copyright (c) 2021 Nordic Semiconductor ASA
# SPDX-License-Identifier: Apache-2.0
#
# This file contains selected Kconfig options for the application.

CONFIG_SENSOR=y
CONFIG_BLINK=y
CONFIG_APP_LOG_LEVEL_INF=y
CONFIG_APP_RESOURCE_MONITOR=y
```

## src/main.c
```c
/*
 * Copyright (c) 2021 Nordic Semiconductor ASA
 * SPDX-License-Identifier: Apache-2.0
 */

#include <zephyr/kernel.h>
#include <zephyr/drivers/sensor.h>
#include <zephyr/logging/log.h>

#include <app/drivers/blink.h>
#include <app/safety_monitor.h>
#include <app/resource_monitor.h>

#include <zephyr/app_version.h>

LOG_MODULE_REGISTER(main, CONFIG_APP_LOG_LEVEL);

#define WARNING_BLINK_PERIOD_MS   500U
#define EMERGENCY_BLINK_PERIOD_MS 100U
#define FAULT_BLINK_PERIOD_MS     250U

static const char *state_name(enum safety_monitor_state state)
{
	switch (state) {
	case SAFETY_MONITOR_NORMAL:
		return "NORMAL";
	case SAFETY_MONITOR_WARNING:
		return "WARNING";
	case SAFETY_MONITOR_EMERGENCY:
		return "EMERGENCY";
	case SAFETY_MONITOR_FAULT:
		return "FAULT";
	default:
		return "UNKNOWN";
	}
}

static unsigned int state_blink_period(enum safety_monitor_state state)
{
	switch (state) {
	case SAFETY_MONITOR_WARNING:
		return WARNING_BLINK_PERIOD_MS;
	case SAFETY_MONITOR_EMERGENCY:
		return EMERGENCY_BLINK_PERIOD_MS;
	case SAFETY_MONITOR_FAULT:
		return FAULT_BLINK_PERIOD_MS;
	case SAFETY_MONITOR_NORMAL:
	default:
		return 0U;
	}
}

int main(void)
{
	int ret;
	const struct device *sensor, *blink;
	struct sensor_value val;
	struct safety_monitor monitor;
	enum safety_monitor_state previous_state;

	safety_monitor_init(&monitor, &(const struct safety_monitor_config){
		.warning_samples = CONFIG_APP_WARNING_SAMPLES,
		.emergency_samples = CONFIG_APP_EMERGENCY_SAMPLES,
		.fault_samples = CONFIG_APP_FAULT_SAMPLES,
	});
	previous_state = safety_monitor_state(&monitor);
	resource_monitor_start();

	printk("Zephyr Safety Monitor Node %s\n", APP_VERSION_STRING);

	sensor = DEVICE_DT_GET(DT_NODELABEL(example_sensor));
	if (!device_is_ready(sensor)) {
		LOG_ERR("Sensor not ready");
		return 0;
	}

	blink = DEVICE_DT_GET(DT_NODELABEL(blink_led));
	if (!device_is_ready(blink)) {
		LOG_ERR("Blink LED not ready");
		return 0;
	}

	ret = blink_off(blink);
	if (ret < 0) {
		LOG_ERR("Could not turn off LED (%d)", ret);
		return 0;
	}

	printk("Safety monitor ready: warning=%u samples, emergency=%u samples\n",
	       CONFIG_APP_WARNING_SAMPLES, CONFIG_APP_EMERGENCY_SAMPLES);

	while (1) {
		int sample_ret = sensor_sample_fetch(sensor);

		if (sample_ret == 0) {
			sample_ret = sensor_channel_get(sensor, SENSOR_CHAN_PROX, &val);
		}

		enum safety_monitor_state state = safety_monitor_update(
			&monitor, sample_ret == 0, sample_ret == 0 && val.val1 != 0);

		if (sample_ret < 0) {
			LOG_ERR("Sensor sample failed (%d)", sample_ret);
		}

		if (state != previous_state) {
			int blink_ret;

			LOG_INF("Safety state: %s -> %s", state_name(previous_state),
				state_name(state));
			blink_ret = blink_set_period_ms(blink, state_blink_period(state));
			if (blink_ret < 0) {
				LOG_ERR("Could not update safety indicator (%d)", blink_ret);
			}
			previous_state = state;
		}

		k_sleep(K_MSEC(CONFIG_APP_SAMPLE_PERIOD_MS));
	}

	return 0;
}
```

## src/can_broadcaster.c
```c
/* SPDX-License-Identifier: Apache-2.0 */

#include <app/can_broadcaster.h>

#include <zephyr/drivers/can.h>

int can_broadcaster_send_state(const struct device *can_dev,
			       enum safety_monitor_state state)
{
	const struct can_frame frame = {
		.id = CAN_BROADCASTER_STATE_ID,
		.dlc = 1,
		.data = { (uint8_t)state },
	};

	return can_send(can_dev, &frame, K_MSEC(100), NULL, NULL);
}
```

## src/resource_monitor.c
```c
/* SPDX-License-Identifier: Apache-2.0 */

#include <app/resource_monitor.h>

#include <zephyr/kernel.h>
#include <zephyr/logging/log.h>
#include <zephyr/debug/thread_analyzer.h>

LOG_MODULE_REGISTER(resource_monitor, CONFIG_APP_LOG_LEVEL);

/*
 * IRQ-mask read: returns 1 if IRQs are currently masked, 0 otherwise. Each
 * Arm profile exposes this through a different register, so this is a real,
 * compilable example of the same bare-metal technique across Cortex-M,
 * Cortex-R and Cortex-A (verify these Kconfig symbols against your pinned
 * Zephyr revision; only the Cortex-M path is exercised by this app's boards).
 */
#if defined(CONFIG_CPU_CORTEX_M)
static inline uint32_t read_irq_mask(void)
{
	uint32_t primask;

	__asm__ volatile("mrs %0, primask" : "=r"(primask));
	return primask & 0x1U;
}
#elif defined(CONFIG_CPU_CORTEX_R)
/* AArch32 Cortex-R: CPSR bit 7 (I) masks IRQs. */
static inline uint32_t read_irq_mask(void)
{
	uint32_t cpsr;

	__asm__ volatile("mrs %0, cpsr" : "=r"(cpsr));
	return (cpsr >> 7) & 0x1U;
}
#elif defined(CONFIG_ARM64)
/* AArch64 Cortex-A: DAIF bit 7 (I) masks IRQs. */
static inline uint32_t read_irq_mask(void)
{
	uint64_t daif;

	__asm__ volatile("mrs %0, daif" : "=r"(daif));
	return (uint32_t)((daif >> 7) & 0x1U);
}
#else
static inline uint32_t read_irq_mask(void)
{
	return 0U;
}
#endif

static struct k_work_delayable report_work;

static void report_work_handler(struct k_work *work)
{
	ARG_UNUSED(work);

	/* cppcheck-suppress knownConditionTrueFalse ; depends on CONFIG_CPU_CORTEX_M */
	LOG_INF("Resource snapshot: irq_masked=%u", read_irq_mask() != 0U);
	thread_analyzer_print(0U);

	k_work_schedule(&report_work, K_MSEC(CONFIG_APP_RESOURCE_MONITOR_PERIOD_MS));
}

void resource_monitor_start(void)
{
	if (!IS_ENABLED(CONFIG_APP_RESOURCE_MONITOR)) {
		return;
	}

	k_work_init_delayable(&report_work, report_work_handler);
	k_work_schedule(&report_work, K_MSEC(CONFIG_APP_RESOURCE_MONITOR_PERIOD_MS));
}
```

## src/safety_monitor.c
```c
/* SPDX-License-Identifier: Apache-2.0 */

#include <app/safety_monitor.h>

static uint8_t at_least_one(uint8_t value)
{
	return value == 0U ? 1U : value;
}

void safety_monitor_init(struct safety_monitor *monitor,
			 const struct safety_monitor_config *config)
{
	monitor->config.warning_samples = at_least_one(config->warning_samples);
	monitor->config.emergency_samples = at_least_one(config->emergency_samples);
	monitor->config.fault_samples = at_least_one(config->fault_samples);
	monitor->state = SAFETY_MONITOR_NORMAL;
	monitor->consecutive_detections = 0U;
	monitor->consecutive_faults = 0U;
}

enum safety_monitor_state safety_monitor_update(struct safety_monitor *monitor,
						bool sample_valid,
						bool hazard_detected)
{
	if (!sample_valid) {
		monitor->consecutive_faults++;
		monitor->consecutive_detections = 0U;
		if (monitor->consecutive_faults >= monitor->config.fault_samples) {
			monitor->state = SAFETY_MONITOR_FAULT;
		}
		return monitor->state;
	}

	monitor->consecutive_faults = 0U;
	if (!hazard_detected) {
		monitor->consecutive_detections = 0U;
		monitor->state = SAFETY_MONITOR_NORMAL;
		return monitor->state;
	}

	if (monitor->consecutive_detections < UINT8_MAX) {
		monitor->consecutive_detections++;
	}
	if (monitor->consecutive_detections >= monitor->config.emergency_samples) {
		monitor->state = SAFETY_MONITOR_EMERGENCY;
	} else if (monitor->consecutive_detections >= monitor->config.warning_samples) {
		monitor->state = SAFETY_MONITOR_WARNING;
	}

	return monitor->state;
}
```
